## package/fosdemx/Config.in
```kconfig
config BR2_PACKAGE_FOSDEMX
	bool "fosdemx demo python firmware"
	help
	  fosdemx demo python firmware
```

## package/python-redis/Config.in
```kconfig
config BR2_PACKAGE_PYTHON_REDIS
	bool "python-redis"
	help
	  A Python redis client module.
	  https://github.com/andymccurdy/redis-py
```
